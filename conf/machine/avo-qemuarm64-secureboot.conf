## conf/machine/avo-qemuarm64-secureboot.conf
```bitbake
MACHINEOVERRIDES =. "qemuarm64:"

require ${COREBASE}/meta/conf/machine/qemuarm64.conf

KMACHINE = "qemuarm64"
MACHINE = "qemuarm64-secureboot"

# secure=on can't ever use KVM, so force it off
QEMU_USE_KVM = ""

QB_MACHINE = "-machine virt,secure=on"
QB_OPT_APPEND += "-no-acpi"
QB_MEM = "-m 1024"
QB_DEFAULT_FSTYPE = "wic.qcow2"
QB_DEFAULT_BIOS = "flash.bin"
QB_FSINFO = "wic:no-kernel-in-fs"
QB_ROOTFS_OPT = ""
QB_KERNEL_ROOT = "/dev/vda2"

IMAGE_FSTYPES = "fwup-img"
FWUP_FILE = "qemu.fwup.conf"

MACHINE_FEATURES += "optee-ftpm"
```

## meta-avocado-atmel/conf/layer.conf
```bitbake
# We have a conf and classes directory, add to BBPATH
BBPATH .= ":${LAYERDIR}"

# We have recipes-* directories, add to BBFILES
BBFILES += "${LAYERDIR}/recipes-*/*/*.bb \
            ${LAYERDIR}/recipes-*/*/*.bbappend"

BBFILE_COLLECTIONS += "meta-avocado-atmel"
BBFILE_PATTERN_meta-avocado-atmel = "^${LAYERDIR}/"
BBFILE_PRIORITY_meta-avocado-atmel = "5"

LAYERDEPENDS_meta-avocado-atmel = "core"
LAYERSERIES_COMPAT_meta-avocado-atmel = "scarthgap"
```

## meta-avocado-example/conf/layer.conf
```bitbake
# We have a conf and classes directory, add to BBPATH
BBPATH .= ":${LAYERDIR}"

# We have recipes-* directories, add to BBFILES
BBFILES += "${LAYERDIR}/recipes-*/*/*.bb \
            ${LAYERDIR}/recipes-*/*/*.bbappend"

BBFILE_COLLECTIONS += "meta-avocado-example"
BBFILE_PATTERN_meta-avocado-example = "^${LAYERDIR}/"
BBFILE_PRIORITY_meta-avocado-example = "5"

LAYERDEPENDS_meta-avocado-example = "core"
LAYERSERIES_COMPAT_meta-avocado-example = "kirkstone"
```

## meta-avocado-meson/conf/layer.conf
```bitbake
# We have a conf and classes directory, add to BBPATH
BBPATH .= ":${LAYERDIR}"

# We have recipes-* directories, add to BBFILES
BBFILES += "${LAYERDIR}/recipes-*/*/*.bb \
            ${LAYERDIR}/recipes-*/*/*.bbappend"

BBFILE_COLLECTIONS += "meta-avocado-meson"
BBFILE_PATTERN_meta-avocado-meson = "^${LAYERDIR}/"
BBFILE_PRIORITY_meta-avocado-meson = "5"

LAYERDEPENDS_meta-avocado-meson = "core"
LAYERSERIES_COMPAT_meta-avocado-meson = "kirkstone"
```

## meta-avocado/conf/distro/avocado.conf
```bitbake
DISTRO = "avocado"
DISTRO_NAME = "AvocadOS"
DISTRO_VERSION = "1.0.0"

PERIDIO_META_PRODUCT ?= "avocados"
PERIDIO_ROOTFS_TYPE ?= "squashfs"
IMAGE_CLASSES += "image_types_fwup"

SDK_VENDOR = "-avocadosdk"
SDK_VERSION := "${@'${DISTRO_VERSION}'.replace('snapshot-${METADATA_REVISION}','snapshot')}"
SDK_VERSION[vardepvalue] = "${SDK_VERSION}"

MAINTAINER = "Peridio Team <info@peridio.com>"

TARGET_VENDOR = "-peridio"

# New ${DISTRO}-<version> setting for sanity checks.
# Increment version number (and the corresponding
# setting int the template bblayers.conf.sample file)
# each time the layer settings are changed.
REQUIRED_AVOCADO_BBLAYERS_CONF_VERSION = "${DISTRO}-1"

LOCALCONF_VERSION = "2"

INITRAMFS_IMAGE = "avocado-image-initramfs"
INITRAMFS_IMAGE_BUNDLE ?= "0"

AVOCADO_DEFAULT_DISTRO_FEATURES = "largefile ptest multiarch virtualization ram overlayfs systemd"

DISTRO_FEATURES ?= "${DISTRO_FEATURES_DEFAULT} ${AVOCADO_DEFAULT_DISTRO_FEATURES}"

PREFERRED_VERSION_linux-yocto ?= "5.15%"
PREFERRED_VERSION_linux-yocto-rt ?= "5.15%"

PREFERRED_PROVIDER_u-boot-fw-utils = "libubootenv"

SDK_NAME = "${DISTRO}-${TCLIBC}-${SDKMACHINE}-${IMAGE_BASENAME}-${TUNE_PKGARCH}-${MACHINE}"
SDKPATHINSTALL = "/opt/${DISTRO}/${SDK_VERSION}"

TCLIBCAPPEND = ""

PACKAGE_CLASSES ?= "package_deb"

SANITY_TESTED_DISTROS ?= " \
            ubuntu-18.04 \n \
            ubuntu-20.04 \n \
            ubuntu-22.04 \n \
            "

require conf/distro/include/no-static-libs.inc
require conf/distro/include/yocto-uninative.inc
require conf/distro/include/security_flags.inc
INHERIT += "uninative"

BB_SIGNATURE_HANDLER ?= "OEEquivHash"
BB_HASHSERVE ??= "auto"
INIT_MANAGER = "systemd"
IMAGE_FSTYPES += "fwup"
```
